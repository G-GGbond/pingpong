## main/Kconfig.projbuild
```kconfig
menu "Xiaozhi Assistant"

    config OTA_URL
        string "Default OTA URL"
        default "https://api.tenclass.net/xiaozhi/ota/"
        help
            The application will access this URL to check for new firmwares and server address.
    
    
    choice
        prompt "Default Language"
        default LANGUAGE_ZH_CN
        help
            Select device display language
    
        config LANGUAGE_ZH_CN
            bool "Chinese"
        config LANGUAGE_ZH_TW
            bool "Chinese Traditional"
        config LANGUAGE_EN_US
            bool "English"
        config LANGUAGE_JA_JP
            bool "Japanese"
    endchoice
    


    
    endmenu
    
```
